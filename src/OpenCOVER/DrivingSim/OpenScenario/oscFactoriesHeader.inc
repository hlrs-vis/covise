#include "oscNone"
#include "oscPolyline"
#include "oscDelete"
#include "oscParameterDeclaration"
#include "oscParameter"
#include "oscFile"
#include "oscDirectory"
#include "oscCatalogs"
#include "oscVehicleCatalog"
#include "oscDriverCatalog"
#include "oscPedestrianCatalog"
#include "oscPedestrianControllerCatalog"
#include "oscMiscObjectCatalog"
#include "oscEnvironmentCatalog"
#include "oscManeuverCatalog"
#include "oscTrajectoryCatalog"
#include "oscRouteCatalog"
#include "oscConditionGroup"
#include "oscCatalogReference"
#include "oscParameterAssignment"
#include "oscSetParameter"
#include "oscUserDataList"
#include "oscUserData"
#include "oscFileHeader"
#include "oscPedestrian"
#include "oscVehicle"
#include "oscPerformance"
#include "oscAxles"
#include "oscAxle"
#include "oscMiscObject"
#include "oscCondition"
#include "oscByEntity"
#include "oscTriggeringEntities"
#include "oscEntity"
#include "oscEntityCondition"
#include "oscEndOfRoad"
#include "oscCollision"
#include "oscCollisionByEntity"
#include "oscByType"
#include "oscOffroad"
#include "oscTimeHeadway"
#include "oscTimeToCollision"
#include "oscCollisionTarget"
#include "oscAcceleration"
#include "oscStandStill"
#include "oscConditionSpeed"
#include "oscRelativeSpeed"
#include "oscTraveledDistance"
#include "oscReachPosition"
#include "oscConditionDistance"
#include "oscRelativeDistance"
#include "oscByState"
#include "oscAtStart"
#include "oscAfterTermination"
#include "oscCommand"
#include "oscSignalState"
#include "oscController"
#include "oscByValue"
#include "oscConditionParameter"
#include "oscTimeOfDay"
#include "oscTime"
#include "oscDate"
#include "oscSimulationTime"
#include "oscPrivateAction"
#include "oscLongitudinal"
#include "oscSpeed"
#include "oscSpeedDynamics"
#include "oscTarget"
#include "oscRelativeTarget"
#include "oscAbsolute"
#include "oscDistanceAction"
#include "oscDynamics"
#include "oscLimited"
#include "oscLateral"
#include "oscLaneChange"
#include "oscLaneChangeDynamics"
#include "oscLaneChangeTarget"
#include "oscRelative"
#include "oscLaneOffset"
#include "oscLaneOffsetDynamics"
#include "oscLaneOffsetTarget"
#include "oscDistance"
#include "oscVisibility"
#include "oscMeeting"
#include "oscAutonomous"
#include "oscActionController"
#include "oscAssign"
#include "oscOverride"
#include "oscThrottle"
#include "oscBrake"
#include "oscClutch"
#include "oscParkingBrake"
#include "oscSteeringWheel"
#include "oscGear"
#include "oscRouting"
#include "oscFollowRoute"
#include "oscFollowTrajectory"
#include "oscLongitudinalParams"
#include "oscTiming"
#include "oscLateralParams"
#include "oscAcquirePosition"
#include "oscUserDefinedAction"
#include "oscScript"
#include "oscGlobalAction"
#include "oscSetEnvironment"
#include "oscActionEntity"
#include "oscAdd"
#include "oscActionParameter"
#include "oscSet"
#include "oscModify"
#include "oscRule"
#include "oscAddRule"
#include "oscMultiply"
#include "oscInfrastructure"
#include "oscInfrastructureSignal"
#include "oscSetController"
#include "oscSetState"
#include "oscTraffic"
#include "oscSource"
#include "oscSink"
#include "oscSwarm"
#include "oscCentralObject"
#include "oscJam"
#include "oscManeuver"
#include "oscEvent"
#include "oscAction"
#include "oscConditions"
#include "oscStart"
#include "oscStartConditionGroup"
#include "oscTrafficDefinition"
#include "oscVehicleDistribution"
#include "oscDriverDistribution"
#include "oscEnvironment"
#include "oscEnvironmentTimeOfDay"
#include "oscWeather"
#include "oscSun"
#include "oscFog"
#include "oscPrecipitation"
#include "oscRoadCondition"
#include "oscEffect"
#include "oscPedestrianController"
#include "oscDriver"
#include "oscPersonDescription"
#include "oscRoute"
#include "oscWaypoint"
#include "oscTrajectory"
#include "oscVertex"
#include "oscShape"
#include "oscClothoid"
#include "oscSpline"
#include "oscControlPoint1"
#include "oscControlPoint2"
#include "oscPosition"
#include "oscWorld"
#include "oscRelativeWorld"
#include "oscRelativeObject"
#include "oscRoad"
#include "oscRelativeRoad"
#include "oscLane"
#include "oscRelativeLane"
#include "oscPositionRoute"
#include "oscRouteRef"
#include "oscRoutePosition"
#include "oscCurrent"
#include "oscRoadCoord"
#include "oscLaneCoord"
#include "oscBoundingBox"
#include "oscCenter"
#include "oscDimension"
#include "oscProperties"
#include "oscProperty"
#include "oscOrientation"
#include "oscOpenSCENARIO"
#include "oscRoadNetwork"
#include "oscSignals"
#include "oscSignalsController"
#include "oscPhase"
#include "oscSignal"
#include "oscEntities"
#include "oscObject"
#include "oscObjectController"
#include "oscSelection"
#include "oscMembers"
#include "oscMembersByEntity"
#include "oscStoryboard"
#include "oscInit"
#include "oscActions"
#include "oscPrivate"
#include "oscStory"
#include "oscAct"
#include "oscSequence"
#include "oscActors"
#include "oscByCondition"
#include "oscActConditions"
#include "oscEnd"
#include "oscCancel"
#include "oscCatalogOpenSCENARIO"
#include "oscCatalogObject"
