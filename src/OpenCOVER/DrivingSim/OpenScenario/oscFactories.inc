staticObjectFactory.registerType<oscNone>("oscNone");
staticObjectFactory.registerType<oscPolyline>("oscPolyline");
staticObjectFactory.registerType<oscDelete>("oscDelete");
staticObjectFactory.registerType<oscParameterDeclaration>("oscParameterDeclaration");
staticObjectFactory.registerType<oscParameter>("oscParameter");
staticObjectFactory.registerType<oscFile>("oscFile");
staticObjectFactory.registerType<oscDirectory>("oscDirectory");
staticObjectFactory.registerType<oscCatalogs>("oscCatalogs");
staticObjectFactory.registerType<oscVehicleCatalog>("oscVehicleCatalog");
staticObjectFactory.registerType<oscDriverCatalog>("oscDriverCatalog");
staticObjectFactory.registerType<oscPedestrianCatalog>("oscPedestrianCatalog");
staticObjectFactory.registerType<oscPedestrianControllerCatalog>("oscPedestrianControllerCatalog");
staticObjectFactory.registerType<oscMiscObjectCatalog>("oscMiscObjectCatalog");
staticObjectFactory.registerType<oscEnvironmentCatalog>("oscEnvironmentCatalog");
staticObjectFactory.registerType<oscManeuverCatalog>("oscManeuverCatalog");
staticObjectFactory.registerType<oscTrajectoryCatalog>("oscTrajectoryCatalog");
staticObjectFactory.registerType<oscRouteCatalog>("oscRouteCatalog");
staticObjectFactory.registerType<oscConditionGroup>("oscConditionGroup");
staticObjectFactory.registerType<oscCatalogReference>("oscCatalogReference");
staticObjectFactory.registerType<oscParameterAssignment>("oscParameterAssignment");
staticObjectFactory.registerType<oscSetParameter>("oscSetParameter");
staticObjectFactory.registerType<oscUserDataList>("oscUserDataList");
staticObjectFactory.registerType<oscUserData>("oscUserData");
staticObjectFactory.registerType<oscFileHeader>("oscFileHeader");
staticObjectFactory.registerType<oscPedestrian>("oscPedestrian");
staticObjectFactory.registerType<oscVehicle>("oscVehicle");
staticObjectFactory.registerType<oscPerformance>("oscPerformance");
staticObjectFactory.registerType<oscAxles>("oscAxles");
staticObjectFactory.registerType<oscAxle>("oscAxle");
staticObjectFactory.registerType<oscMiscObject>("oscMiscObject");
staticObjectFactory.registerType<oscCondition>("oscCondition");
staticObjectFactory.registerType<oscByEntity>("oscByEntity");
staticObjectFactory.registerType<oscTriggeringEntities>("oscTriggeringEntities");
staticObjectFactory.registerType<oscEntity>("oscEntity");
staticObjectFactory.registerType<oscEntityCondition>("oscEntityCondition");
staticObjectFactory.registerType<oscEndOfRoad>("oscEndOfRoad");
staticObjectFactory.registerType<oscCollision>("oscCollision");
staticObjectFactory.registerType<oscCollisionByEntity>("oscCollisionByEntity");
staticObjectFactory.registerType<oscByType>("oscByType");
staticObjectFactory.registerType<oscOffroad>("oscOffroad");
staticObjectFactory.registerType<oscTimeHeadway>("oscTimeHeadway");
staticObjectFactory.registerType<oscTimeToCollision>("oscTimeToCollision");
staticObjectFactory.registerType<oscCollisionTarget>("oscCollisionTarget");
staticObjectFactory.registerType<oscAcceleration>("oscAcceleration");
staticObjectFactory.registerType<oscStandStill>("oscStandStill");
staticObjectFactory.registerType<oscConditionSpeed>("oscConditionSpeed");
staticObjectFactory.registerType<oscRelativeSpeed>("oscRelativeSpeed");
staticObjectFactory.registerType<oscTraveledDistance>("oscTraveledDistance");
staticObjectFactory.registerType<oscReachPosition>("oscReachPosition");
staticObjectFactory.registerType<oscConditionDistance>("oscConditionDistance");
staticObjectFactory.registerType<oscRelativeDistance>("oscRelativeDistance");
staticObjectFactory.registerType<oscByState>("oscByState");
staticObjectFactory.registerType<oscAtStart>("oscAtStart");
staticObjectFactory.registerType<oscAfterTermination>("oscAfterTermination");
staticObjectFactory.registerType<oscCommand>("oscCommand");
staticObjectFactory.registerType<oscSignalState>("oscSignalState");
staticObjectFactory.registerType<oscController>("oscController");
staticObjectFactory.registerType<oscByValue>("oscByValue");
staticObjectFactory.registerType<oscConditionParameter>("oscConditionParameter");
staticObjectFactory.registerType<oscTimeOfDay>("oscTimeOfDay");
staticObjectFactory.registerType<oscTime>("oscTime");
staticObjectFactory.registerType<oscDate>("oscDate");
staticObjectFactory.registerType<oscSimulationTime>("oscSimulationTime");
staticObjectFactory.registerType<oscPrivateAction>("oscPrivateAction");
staticObjectFactory.registerType<oscLongitudinal>("oscLongitudinal");
staticObjectFactory.registerType<oscSpeed>("oscSpeed");
staticObjectFactory.registerType<oscSpeedDynamics>("oscSpeedDynamics");
staticObjectFactory.registerType<oscTarget>("oscTarget");
staticObjectFactory.registerType<oscRelativeTarget>("oscRelativeTarget");
staticObjectFactory.registerType<oscAbsolute>("oscAbsolute");
staticObjectFactory.registerType<oscDistanceAction>("oscDistanceAction");
staticObjectFactory.registerType<oscDynamics>("oscDynamics");
staticObjectFactory.registerType<oscLateral>("oscLateral");
staticObjectFactory.registerType<oscLaneChange>("oscLaneChange");
staticObjectFactory.registerType<oscLaneChangeDynamics>("oscLaneChangeDynamics");
staticObjectFactory.registerType<oscExtent>("oscExtent");
staticObjectFactory.registerType<oscLaneChangeTarget>("oscLaneChangeTarget");
staticObjectFactory.registerType<oscRelative>("oscRelative");
staticObjectFactory.registerType<oscLaneOffset>("oscLaneOffset");
staticObjectFactory.registerType<oscLaneOffsetDynamics>("oscLaneOffsetDynamics");
staticObjectFactory.registerType<oscLaneOffsetTarget>("oscLaneOffsetTarget");
staticObjectFactory.registerType<oscDistance>("oscDistance");
staticObjectFactory.registerType<oscVisibility>("oscVisibility");
staticObjectFactory.registerType<oscMeeting>("oscMeeting");
staticObjectFactory.registerType<oscAutonomous>("oscAutonomous");
staticObjectFactory.registerType<oscActionController>("oscActionController");
staticObjectFactory.registerType<oscAssign>("oscAssign");
staticObjectFactory.registerType<oscOverride>("oscOverride");
staticObjectFactory.registerType<oscThrottle>("oscThrottle");
staticObjectFactory.registerType<oscBrake>("oscBrake");
staticObjectFactory.registerType<oscClutch>("oscClutch");
staticObjectFactory.registerType<oscParkingBrake>("oscParkingBrake");
staticObjectFactory.registerType<oscSteeringWheel>("oscSteeringWheel");
staticObjectFactory.registerType<oscGear>("oscGear");
staticObjectFactory.registerType<oscRouting>("oscRouting");
staticObjectFactory.registerType<oscFollowRoute>("oscFollowRoute");
staticObjectFactory.registerType<oscFollowTrajectory>("oscFollowTrajectory");
staticObjectFactory.registerType<oscLongitudinalParams>("oscLongitudinalParams");
staticObjectFactory.registerType<oscTiming>("oscTiming");
staticObjectFactory.registerType<oscLateralParams>("oscLateralParams");
staticObjectFactory.registerType<oscAcquirePosition>("oscAcquirePosition");
staticObjectFactory.registerType<oscUserDefinedAction>("oscUserDefinedAction");
staticObjectFactory.registerType<oscScript>("oscScript");
staticObjectFactory.registerType<oscGlobalAction>("oscGlobalAction");
staticObjectFactory.registerType<oscSetEnvironment>("oscSetEnvironment");
staticObjectFactory.registerType<oscActionEntity>("oscActionEntity");
staticObjectFactory.registerType<oscAdd>("oscAdd");
staticObjectFactory.registerType<oscActionParameter>("oscActionParameter");
staticObjectFactory.registerType<oscSet>("oscSet");
staticObjectFactory.registerType<oscModify>("oscModify");
staticObjectFactory.registerType<oscRule>("oscRule");
staticObjectFactory.registerType<oscAddRule>("oscAddRule");
staticObjectFactory.registerType<oscMultiply>("oscMultiply");
staticObjectFactory.registerType<oscInfrastructure>("oscInfrastructure");
staticObjectFactory.registerType<oscInfrastructureSignal>("oscInfrastructureSignal");
staticObjectFactory.registerType<oscSetController>("oscSetController");
staticObjectFactory.registerType<oscSetState>("oscSetState");
staticObjectFactory.registerType<oscTraffic>("oscTraffic");
staticObjectFactory.registerType<oscSource>("oscSource");
staticObjectFactory.registerType<oscSink>("oscSink");
staticObjectFactory.registerType<oscSwarm>("oscSwarm");
staticObjectFactory.registerType<oscCentralObject>("oscCentralObject");
staticObjectFactory.registerType<oscJam>("oscJam");
staticObjectFactory.registerType<oscManeuver>("oscManeuver");
staticObjectFactory.registerType<oscEvent>("oscEvent");
staticObjectFactory.registerType<oscAction>("oscAction");
staticObjectFactory.registerType<oscConditions>("oscConditions");
staticObjectFactory.registerType<oscStart>("oscStart");
staticObjectFactory.registerType<oscStartConditionGroup>("oscStartConditionGroup");
staticObjectFactory.registerType<oscTrafficDefinition>("oscTrafficDefinition");
staticObjectFactory.registerType<oscVehicleDistribution>("oscVehicleDistribution");
staticObjectFactory.registerType<oscDriverDistribution>("oscDriverDistribution");
staticObjectFactory.registerType<oscEnvironment>("oscEnvironment");
staticObjectFactory.registerType<oscEnvironmentTimeOfDay>("oscEnvironmentTimeOfDay");
staticObjectFactory.registerType<oscWeather>("oscWeather");
staticObjectFactory.registerType<oscSun>("oscSun");
staticObjectFactory.registerType<oscFog>("oscFog");
staticObjectFactory.registerType<oscPrecipitation>("oscPrecipitation");
staticObjectFactory.registerType<oscRoadCondition>("oscRoadCondition");
staticObjectFactory.registerType<oscEffect>("oscEffect");
staticObjectFactory.registerType<oscPedestrianController>("oscPedestrianController");
staticObjectFactory.registerType<oscDriver>("oscDriver");
staticObjectFactory.registerType<oscRoute>("oscRoute");
staticObjectFactory.registerType<oscWaypoint>("oscWaypoint");
staticObjectFactory.registerType<oscTrajectory>("oscTrajectory");
staticObjectFactory.registerType<oscVertex>("oscVertex");
staticObjectFactory.registerType<oscShape>("oscShape");
staticObjectFactory.registerType<oscClothoid>("oscClothoid");
staticObjectFactory.registerType<oscSpline>("oscSpline");
staticObjectFactory.registerType<oscControlPoint1>("oscControlPoint1");
staticObjectFactory.registerType<oscControlPoint2>("oscControlPoint2");
staticObjectFactory.registerType<oscPosition>("oscPosition");
staticObjectFactory.registerType<oscWorld>("oscWorld");
staticObjectFactory.registerType<oscRelativeWorld>("oscRelativeWorld");
staticObjectFactory.registerType<oscOrientation>("oscOrientation");
staticObjectFactory.registerType<oscRelativeObject>("oscRelativeObject");
staticObjectFactory.registerType<oscRoad>("oscRoad");
staticObjectFactory.registerType<oscRelativeRoad>("oscRelativeRoad");
staticObjectFactory.registerType<oscLane>("oscLane");
staticObjectFactory.registerType<oscRelativeLane>("oscRelativeLane");
staticObjectFactory.registerType<oscPositionRoute>("oscPositionRoute");
staticObjectFactory.registerType<oscRoutePosition>("oscRoutePosition");
staticObjectFactory.registerType<oscCurrent>("oscCurrent");
staticObjectFactory.registerType<oscRoadCoord>("oscRoadCoord");
staticObjectFactory.registerType<oscLaneCoord>("oscLaneCoord");
staticObjectFactory.registerType<oscBoundingBox>("oscBoundingBox");
staticObjectFactory.registerType<oscCenter>("oscCenter");
staticObjectFactory.registerType<oscDimension>("oscDimension");
staticObjectFactory.registerType<oscProperties>("oscProperties");
staticObjectFactory.registerType<oscProperty>("oscProperty");
staticObjectFactory.registerType<oscOpenSCENARIO>("oscOpenSCENARIO");
staticObjectFactory.registerType<oscRoadNetwork>("oscRoadNetwork");
staticObjectFactory.registerType<oscSignals>("oscSignals");
staticObjectFactory.registerType<oscSignalsController>("oscSignalsController");
staticObjectFactory.registerType<oscPhase>("oscPhase");
staticObjectFactory.registerType<oscSignal>("oscSignal");
staticObjectFactory.registerType<oscEntities>("oscEntities");
staticObjectFactory.registerType<oscObject>("oscObject");
staticObjectFactory.registerType<oscObjectController>("oscObjectController");
staticObjectFactory.registerType<oscSelection>("oscSelection");
staticObjectFactory.registerType<oscMembers>("oscMembers");
staticObjectFactory.registerType<oscMembersByEntity>("oscMembersByEntity");
staticObjectFactory.registerType<oscStoryboard>("oscStoryboard");
staticObjectFactory.registerType<oscInit>("oscInit");
staticObjectFactory.registerType<oscActions>("oscActions");
staticObjectFactory.registerType<oscPrivate>("oscPrivate");
staticObjectFactory.registerType<oscStory>("oscStory");
staticObjectFactory.registerType<oscAct>("oscAct");
staticObjectFactory.registerType<oscSequence>("oscSequence");
staticObjectFactory.registerType<oscActors>("oscActors");
staticObjectFactory.registerType<oscByCondition>("oscByCondition");
staticObjectFactory.registerType<oscActConditions>("oscActConditions");
staticObjectFactory.registerType<oscEnd>("oscEnd");
staticObjectFactory.registerType<oscCancel>("oscCancel");
staticObjectFactory.registerType<oscCatalogOpenSCENARIO>("oscCatalogOpenSCENARIO");
staticObjectFactory.registerType<oscCatalogObject>("oscCatalogObject");
