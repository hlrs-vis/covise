SET(SCHEMA_HEADERS
schema/oscNone.h
schema/oscPolyline.h
schema/oscDelete.h
schema/oscParameterDeclaration.h
schema/oscParameter.h
schema/oscFile.h
schema/oscDirectory.h
schema/oscCatalogs.h
schema/oscVehicleCatalog.h
schema/oscDriverCatalog.h
schema/oscPedestrianCatalog.h
schema/oscPedestrianControllerCatalog.h
schema/oscMiscObjectCatalog.h
schema/oscEnvironmentCatalog.h
schema/oscManeuverCatalog.h
schema/oscTrajectoryCatalog.h
schema/oscRouteCatalog.h
schema/oscConditionGroup.h
schema/oscCatalogReference.h
schema/oscParameterAssignment.h
schema/oscSetParameter.h
schema/oscUserDataList.h
schema/oscUserData.h
schema/oscFileHeader.h
schema/oscPedestrian.h
schema/oscVehicle.h
schema/oscPerformance.h
schema/oscAxles.h
schema/oscAxle.h
schema/oscMiscObject.h
schema/oscCondition.h
schema/oscByEntity.h
schema/oscTriggeringEntities.h
schema/oscEntity.h
schema/oscEntityCondition.h
schema/oscEndOfRoad.h
schema/oscCollision.h
schema/oscCollisionByEntity.h
schema/oscByType.h
schema/oscOffroad.h
schema/oscTimeHeadway.h
schema/oscTimeToCollision.h
schema/oscCollisionTarget.h
schema/oscAcceleration.h
schema/oscStandStill.h
schema/oscConditionSpeed.h
schema/oscRelativeSpeed.h
schema/oscTraveledDistance.h
schema/oscReachPosition.h
schema/oscConditionDistance.h
schema/oscRelativeDistance.h
schema/oscByState.h
schema/oscAtStart.h
schema/oscAfterTermination.h
schema/oscCommand.h
schema/oscSignalState.h
schema/oscController.h
schema/oscByValue.h
schema/oscConditionParameter.h
schema/oscTimeOfDay.h
schema/oscTime.h
schema/oscDate.h
schema/oscSimulationTime.h
schema/oscPrivateAction.h
schema/oscLongitudinal.h
schema/oscSpeed.h
schema/oscSpeedDynamics.h
schema/oscTarget.h
schema/oscRelativeTarget.h
schema/oscAbsolute.h
schema/oscDistanceAction.h
schema/oscDynamics.h
schema/oscLimited.h
schema/oscLateral.h
schema/oscLaneChange.h
schema/oscLaneChangeDynamics.h
schema/oscExtent.h
schema/oscLaneChangeTarget.h
schema/oscRelative.h
schema/oscLaneOffset.h
schema/oscLaneOffsetDynamics.h
schema/oscLaneOffsetTarget.h
schema/oscDistance.h
schema/oscVisibility.h
schema/oscMeeting.h
schema/oscAutonomous.h
schema/oscActionController.h
schema/oscAssign.h
schema/oscOverride.h
schema/oscThrottle.h
schema/oscBrake.h
schema/oscClutch.h
schema/oscParkingBrake.h
schema/oscSteeringWheel.h
schema/oscGear.h
schema/oscRouting.h
schema/oscFollowRoute.h
schema/oscFollowTrajectory.h
schema/oscLongitudinalParams.h
schema/oscTiming.h
schema/oscLateralParams.h
schema/oscAcquirePosition.h
schema/oscUserDefinedAction.h
schema/oscScript.h
schema/oscGlobalAction.h
schema/oscSetEnvironment.h
schema/oscActionEntity.h
schema/oscAdd.h
schema/oscActionParameter.h
schema/oscSet.h
schema/oscModify.h
schema/oscRule.h
schema/oscAddRule.h
schema/oscMultiply.h
schema/oscInfrastructure.h
schema/oscInfrastructureSignal.h
schema/oscSetController.h
schema/oscSetState.h
schema/oscTraffic.h
schema/oscSource.h
schema/oscSink.h
schema/oscSwarm.h
schema/oscCentralObject.h
schema/oscJam.h
schema/oscManeuver.h
schema/oscEvent.h
schema/oscAction.h
schema/oscConditions.h
schema/oscStart.h
schema/oscStartConditionGroup.h
schema/oscTrafficDefinition.h
schema/oscVehicleDistribution.h
schema/oscDriverDistribution.h
schema/oscEnvironment.h
schema/oscEnvironmentTimeOfDay.h
schema/oscWeather.h
schema/oscSun.h
schema/oscFog.h
schema/oscPrecipitation.h
schema/oscRoadCondition.h
schema/oscEffect.h
schema/oscPedestrianController.h
schema/oscDescription.h
schema/oscDriver.h
schema/oscRoute.h
schema/oscWaypoint.h
schema/oscTrajectory.h
schema/oscVertex.h
schema/oscShape.h
schema/oscClothoid.h
schema/oscSpline.h
schema/oscControlPoint1.h
schema/oscControlPoint2.h
schema/oscPosition.h
schema/oscWorld.h
schema/oscRelativeWorld.h
schema/oscOrientation.h
schema/oscRelativeObject.h
schema/oscRoad.h
schema/oscRelativeRoad.h
schema/oscLane.h
schema/oscRelativeLane.h
schema/oscPositionRoute.h
schema/oscRoutePosition.h
schema/oscCurrent.h
schema/oscRoadCoord.h
schema/oscLaneCoord.h
schema/oscBoundingBox.h
schema/oscCenter.h
schema/oscDimension.h
schema/oscProperties.h
schema/oscProperty.h
schema/oscRoadNetwork.h
schema/oscSignals.h
schema/oscSignalsController.h
schema/oscPhase.h
schema/oscSignal.h
schema/oscEntities.h
schema/oscObject.h
schema/oscObjectController.h
schema/oscSelection.h
schema/oscMembers.h
schema/oscMembersByEntity.h
schema/oscStoryboard.h
schema/oscInit.h
schema/oscActions.h
schema/oscPrivate.h
schema/oscStory.h
schema/oscAct.h
schema/oscSequence.h
schema/oscActors.h
schema/oscByCondition.h
schema/oscActConditions.h
schema/oscEnd.h
schema/oscCancel.h
schema/oscCatalogObject.h
)
SET(SCHEMA_SOURCES
schema/oscParameter.cpp
schema/oscPedestrian.cpp
schema/oscVehicle.cpp
schema/oscMiscObject.cpp
schema/oscCondition.cpp
schema/oscTriggeringEntities.cpp
schema/oscByType.cpp
schema/oscTimeHeadway.cpp
schema/oscRelativeDistance.cpp
schema/oscAtStart.cpp
schema/oscAfterTermination.cpp
schema/oscSpeedDynamics.cpp
schema/oscRelativeTarget.cpp
schema/oscMeeting.cpp
schema/oscAutonomous.cpp
schema/oscTiming.cpp
schema/oscLateralParams.cpp
schema/oscScript.cpp
schema/oscEvent.cpp
schema/oscWeather.cpp
schema/oscPrecipitation.cpp
schema/oscDescription.cpp
schema/oscWaypoint.cpp
schema/oscTrajectory.cpp
schema/oscOrientation.cpp
schema/oscByCondition.cpp
)
