c!!$
c!!$ DTF Version 5.9.x
c!!$
      IMPLICIT NONE

      INTEGER dtf_query_dtf_version_f
      INTEGER dtf_query_file_version_f
      INTEGER dtf_ok_f
      INTEGER dtf_last_error_f
      INTEGER dtf_info_last_error_f
      INTEGER dtf_clear_error_f
      INTEGER dtf_new_file_f
      INTEGER dtf_open_file_f
      INTEGER dtf_close_file_f
      INTEGER dtf_close_all_files_f
      INTEGER dtf_set_scaling_d_f
      INTEGER dtf_set_scaling_s_f
      REAL*8 dtf_query_scaling_d_f
      REAL*4 dtf_query_scaling_s_f
      INTEGER dtf_set_application_f
      INTEGER dtf_query_application_f
      INTEGER dtf_set_appversion_f
      INTEGER dtf_query_appversion_f
      INTEGER dtf_set_title_f
      INTEGER dtf_query_title_f
      INTEGER dtf_set_origin_f
      INTEGER dtf_query_origin_f
      INTEGER dtf_query_cretime_f
      INTEGER dtf_query_modtime_f
      INTEGER dtf_check_patches_f
      INTEGER dtf_file_info_f
      INTEGER dtf_file_contents_f
      INTEGER dtf_test_file_f
      INTEGER dtf_query_nsims_f
      INTEGER dtf_add_sim_f
      INTEGER dtf_copy_sim_f
      INTEGER dtf_delete_sim_f
      INTEGER dtf_update_simdescr_f
      INTEGER dtf_query_simdescr_f
      INTEGER dtf_query_minmax_sim_d_f
      INTEGER dtf_query_minmax_sim_s_f
      INTEGER dtf_query_nzones_f
      INTEGER dtf_query_zonetype_f
      INTEGER dtf_query_isstruct_f
      INTEGER dtf_query_iscartesian_f
      INTEGER dtf_query_isunstruct_f
      INTEGER dtf_query_ispoint_f
      INTEGER dtf_query_ispoly_f
      INTEGER dtf_query_is_2d_f
      INTEGER dtf_delete_zone_f
      INTEGER dtf_is_blanking_data_present_f
      INTEGER dtf_read_blanking_f
      INTEGER dtf_update_blanking_f
      INTEGER dtf_query_dims_f
      INTEGER dtf_query_nnodes_f
      INTEGER dtf_query_nnodes_struct_f
      INTEGER dtf_update_grid_d_f
      INTEGER dtf_update_grid_s_f
      INTEGER dtf_read_grid_d_f
      INTEGER dtf_read_grid_s_f
      INTEGER dtf_query_minmax_zone_d_f
      INTEGER dtf_query_minmax_zone_s_f
      INTEGER dtf_add_struct_d_f
      INTEGER dtf_add_struct_s_f
      INTEGER dtf_update_struct_double_f
      INTEGER dtf_update_struct_single_f
      INTEGER dtf_add_unstruct_d_f
      INTEGER dtf_add_unstruct_s_f
      INTEGER dtf_update_unstruct_double_f
      INTEGER dtf_update_unstruct_single_f
      INTEGER dtf_add_poly_d_f
      INTEGER dtf_add_poly_s_f
      INTEGER dtf_update_poly_double_f
      INTEGER dtf_update_poly_single_f
      INTEGER dtf_query_ispoly_sorted_f
      INTEGER dtf_sort_poly_f
      INTEGER dtf_query_poly_sizes_f
      INTEGER dtf_query_nfaces_f
      INTEGER dtf_query_nfaces_struct_f
      INTEGER dtf_query_faces_f
      INTEGER dtf_query_f2n_pos_f
      INTEGER dtf_query_facekind_f
      INTEGER dtf_query_ncells_f
      INTEGER dtf_query_cells_f
      INTEGER dtf_query_celltype_f
      INTEGER dtf_query_c2n_pos_f
      INTEGER dtf_query_n2c_f
      INTEGER dtf_read_n2c_f
      INTEGER dtf_query_f2n_f
      INTEGER dtf_read_f2n_f
      INTEGER dtf_query_f2c_f
      INTEGER dtf_read_f2c_f
      INTEGER dtf_query_c2n_f
      INTEGER dtf_read_c2n_f
      INTEGER dtf_query_c2f_f
      INTEGER dtf_read_c2f_f
      INTEGER dtf_read_virtual_nodenums_f
      INTEGER dtf_read_struct_zone_virtual_nodenums_f
      INTEGER dtf_read_virtual_facenums_f
      INTEGER dtf_read_virtual_cellnums_f
      INTEGER dtf_query_nvzds_of_topotype_f
      INTEGER dtf_query_nvzds_f
      INTEGER dtf_read_vzdnums_of_topotype_f
      INTEGER dtf_query_vzd_by_num_f
      INTEGER dtf_query_vzd_by_name_f
      INTEGER dtf_read_vzd_by_num_f
      INTEGER dtf_read_vzd_by_name_f
      INTEGER dtf_update_vzd_by_num_f
      INTEGER dtf_update_vzd_by_name_f
      INTEGER dtf_query_vz_bcrec_num_f
      INTEGER dtf_query_bf2bcr_f
      INTEGER dtf_read_bf2bcr_f
      INTEGER dtf_read_bf2nbcr_f
      INTEGER dtf_update_bf2bcr_f
      INTEGER dtf_update_bf2n_bf2bcr_f
      INTEGER dtf_read_xf2bcr_f
      INTEGER dtf_read_xf2nbcr_f
      INTEGER dtf_update_xf2bcr_f
      INTEGER dtf_update_xf2n_xf2bcr_f
      INTEGER dtf_query_xf2bcr_f
      INTEGER dtf_query_bfnum_by_fnum_f
      INTEGER dtf_query_ifnum_by_fnum_f
      INTEGER dtf_add_zd_f
      INTEGER dtf_add_zd_strings_f
      INTEGER dtf_add_zd_int_f
      INTEGER dtf_add_zd_int_array_f
      INTEGER dtf_add_zd_single_f
      INTEGER dtf_add_zd_single_array_f
      INTEGER dtf_add_zd_double_f
      INTEGER dtf_add_zd_double_array_f
      INTEGER dtf_add_zd_string_f
      INTEGER dtf_add_zd_string_array_f
      INTEGER dtf_delete_zd_by_num_f
      INTEGER dtf_delete_zd_by_name_f
      INTEGER dtf_update_zd_by_num_f
      INTEGER dtf_update_zd_strings_by_num_f
      INTEGER dtf_update_zd_int_by_num_f
      INTEGER dtf_update_zd_int_array_by_num_f
      INTEGER dtf_update_zd_single_by_num_f
      INTEGER dtf_update_zd_single_array_by_num_f
      INTEGER dtf_update_zd_double_by_num_f
      INTEGER dtf_update_zd_double_array_by_num_f
      INTEGER dtf_update_zd_string_by_num_f
      INTEGER dtf_update_zd_string_array_by_num_f
      INTEGER dtf_update_zd_by_name_f
      INTEGER dtf_update_zd_strings_by_name_f
      INTEGER dtf_update_zd_int_by_name_f
      INTEGER dtf_update_zd_int_array_by_name_f
      INTEGER dtf_update_zd_single_by_name_f
      INTEGER dtf_update_zd_single_array_by_name_f
      INTEGER dtf_update_zd_double_by_name_f
      INTEGER dtf_update_zd_double_array_by_name_f
      INTEGER dtf_update_zd_string_by_name_f
      INTEGER dtf_update_zd_string_array_by_name_f
      INTEGER dtf_query_nzds_f
      INTEGER dtf_query_nzds_of_topotype_f
      INTEGER dtf_read_zdnums_of_topotype_f
      INTEGER dtf_query_zd_by_num_f
      INTEGER dtf_query_zd_by_name_f
      INTEGER dtf_read_zd_by_num_f
      INTEGER dtf_read_zd_strings_by_num_f
      INTEGER dtf_read_zd_int_by_num_f
      INTEGER dtf_read_zd_int_array_by_num_f
      INTEGER dtf_read_zd_single_by_num_f
      INTEGER dtf_read_zd_single_array_by_num_f
      INTEGER dtf_read_zd_double_by_num_f
      INTEGER dtf_read_zd_double_array_by_num_f
      INTEGER dtf_read_zd_string_by_num_f
      INTEGER dtf_read_zd_string_array_by_num_f
      INTEGER dtf_read_zd_by_name_f
      INTEGER dtf_read_zd_strings_by_name_f
      INTEGER dtf_read_zd_int_by_name_f
      INTEGER dtf_read_zd_int_array_by_name_f
      INTEGER dtf_read_zd_single_by_name_f
      INTEGER dtf_read_zd_single_array_by_name_f
      INTEGER dtf_read_zd_double_by_name_f
      INTEGER dtf_read_zd_double_array_by_name_f
      INTEGER dtf_read_zd_string_by_name_f
      INTEGER dtf_read_zd_string_array_by_name_f
      INTEGER dtf_query_zd_minmax_by_name_f
      INTEGER dtf_delete_all_zd_of_topotype_f
      INTEGER dtf_query_zd_int_minmax_by_name_f
      INTEGER dtf_query_zd_single_minmax_by_name_f
      INTEGER dtf_query_zd_double_minmax_by_name_f
      INTEGER dtf_add_sd_f
      INTEGER dtf_add_sd_strings_f
      INTEGER dtf_add_sd_int_f
      INTEGER dtf_add_sd_int_array_f
      INTEGER dtf_add_sd_single_f
      INTEGER dtf_add_sd_single_array_f
      INTEGER dtf_add_sd_double_f
      INTEGER dtf_add_sd_double_array_f
      INTEGER dtf_add_sd_string_f
      INTEGER dtf_add_sd_string_array_f
      INTEGER dtf_delete_sd_by_num_f
      INTEGER dtf_delete_sd_by_name_f
      INTEGER dtf_query_nsds_f
      INTEGER dtf_update_sd_by_num_f
      INTEGER dtf_update_sd_strings_by_num_f
      INTEGER dtf_update_sd_int_by_num_f
      INTEGER dtf_update_sd_int_array_by_num_f
      INTEGER dtf_update_sd_single_by_num_f
      INTEGER dtf_update_sd_single_array_by_num_f
      INTEGER dtf_update_sd_double_by_num_f
      INTEGER dtf_update_sd_double_array_by_num_f
      INTEGER dtf_update_sd_string_by_num_f
      INTEGER dtf_update_sd_string_array_by_num_f
      INTEGER dtf_update_sd_by_name_f
      INTEGER dtf_update_sd_strings_by_name_f
      INTEGER dtf_update_sd_int_by_name_f
      INTEGER dtf_update_sd_int_array_by_name_f
      INTEGER dtf_update_sd_single_by_name_f
      INTEGER dtf_update_sd_single_array_by_name_f
      INTEGER dtf_update_sd_double_by_name_f
      INTEGER dtf_update_sd_double_array_by_name_f
      INTEGER dtf_update_sd_string_by_name_f
      INTEGER dtf_update_sd_string_array_by_name_f
      INTEGER dtf_query_nsds_of_topotype_f
      INTEGER dtf_read_sdnums_of_topotype_f
      INTEGER dtf_query_sd_by_num_f
      INTEGER dtf_query_sd_by_name_f
      INTEGER dtf_read_sd_by_num_f
      INTEGER dtf_read_sd_strings_by_num_f
      INTEGER dtf_read_sd_int_by_num_f
      INTEGER dtf_read_sd_int_array_by_num_f
      INTEGER dtf_read_sd_single_by_num_f
      INTEGER dtf_read_sd_single_array_by_num_f
      INTEGER dtf_read_sd_double_by_num_f
      INTEGER dtf_read_sd_double_array_by_num_f
      INTEGER dtf_read_sd_string_by_num_f
      INTEGER dtf_read_sd_string_array_by_num_f
      INTEGER dtf_read_sd_by_name_f
      INTEGER dtf_read_sd_strings_by_name_f
      INTEGER dtf_read_sd_int_by_name_f
      INTEGER dtf_read_sd_int_array_by_name_f
      INTEGER dtf_read_sd_single_by_name_f
      INTEGER dtf_read_sd_single_array_by_name_f
      INTEGER dtf_read_sd_double_by_name_f
      INTEGER dtf_read_sd_double_array_by_name_f
      INTEGER dtf_read_sd_string_by_name_f
      INTEGER dtf_read_sd_string_array_by_name_f
      INTEGER dtf_query_sd_minmax_by_name_f
      INTEGER dtf_query_sd_int_minmax_by_name_f
      INTEGER dtf_query_sd_single_minmax_by_name_f
      INTEGER dtf_query_sd_double_minmax_by_name_f
      INTEGER dtf_query_nbcrecords_f
      INTEGER dtf_query_bcrecord_f
      INTEGER dtf_update_bcrecord_f
      INTEGER dtf_copy_bcrecord_f
      INTEGER dtf_delete_bcrecord_f
      INTEGER dtf_query_bc_category_f
      INTEGER dtf_query_bc_category_value_f
      INTEGER dtf_update_bc_categories_f
      INTEGER dtf_query_bcval_name_f
      INTEGER dtf_query_bcval_eval_method_f
      INTEGER dtf_query_bcval_eval_data_f
      INTEGER dtf_read_bcval_eval_data_d_f
      INTEGER dtf_read_bcval_eval_data_s_f
      INTEGER dtf_read_bcval_int_f
      INTEGER dtf_read_bcval_real_d_f
      INTEGER dtf_read_bcval_real_s_f
      INTEGER dtf_read_bcval_string_f
      INTEGER dtf_update_bcval_f
      INTEGER dtf_update_bcval_ints_f
      INTEGER dtf_update_bcval_reals_d_f
      INTEGER dtf_update_bcval_reals_s_f
      INTEGER dtf_update_bcval_strings_f
      INTEGER dtf_update_bcval_int_by_name_f
      INTEGER dtf_update_bcval_real_d_by_name_f
      INTEGER dtf_update_bcval_real_s_by_name_f
      INTEGER dtf_update_bcval_string_by_name_f
      INTEGER dtf_delete_bcval_f
      INTEGER dtf_delete_all_bcvals_f
      INTEGER dtf_query_npatches_f
      INTEGER dtf_query_patch_f
      INTEGER dtf_read_patch_f
      INTEGER dtf_update_patch_f
      INTEGER dtf_delete_patch_f
      INTEGER dtf_query_nrecords_in_patch_f
      INTEGER dtf_query_nface_groups_f
      INTEGER dtf_query_face_group_f
      INTEGER dtf_read_face_group_f
      INTEGER dtf_query_nsurface_conditions_f
      INTEGER dtf_query_surface_condition_f
      INTEGER dtf_query_nvcrecords_f
      INTEGER dtf_query_vcrecord_f
      INTEGER dtf_update_vcrecord_f
      INTEGER dtf_copy_vcrecord_f
      INTEGER dtf_delete_vcrecord_f
      INTEGER dtf_query_vcval_name_f
      INTEGER dtf_query_vcval_eval_method_f
      INTEGER dtf_query_vcval_eval_data_f
      INTEGER dtf_read_vcval_eval_data_d_f
      INTEGER dtf_read_vcval_eval_data_s_f
      INTEGER dtf_read_vcval_int_f
      INTEGER dtf_read_vcval_real_d_f
      INTEGER dtf_read_vcval_real_s_f
      INTEGER dtf_read_vcval_string_f
      INTEGER dtf_update_vcval_f
      INTEGER dtf_update_vcval_ints_f
      INTEGER dtf_update_vcval_reals_d_f
      INTEGER dtf_update_vcval_reals_s_f
      INTEGER dtf_update_vcval_strings_f
      INTEGER dtf_update_vcval_int_by_name_f
      INTEGER dtf_update_vcval_real_d_by_name_f
      INTEGER dtf_update_vcval_real_s_by_name_f
      INTEGER dtf_update_vcval_string_by_name_f
      INTEGER dtf_delete_vcval_f
      INTEGER dtf_delete_all_vcvals_f
      INTEGER dtf_query_nblocks_f
      INTEGER dtf_query_block_f
      INTEGER dtf_update_block_f
      INTEGER dtf_delete_block_f
      INTEGER dtf_query_ncell_groups_f
      INTEGER dtf_query_cell_group_f
      INTEGER dtf_read_cell_group_f
      INTEGER dtf_update_cell_group_f
      INTEGER dtf_delete_cell_group_f
      INTEGER dtf_query_nvolume_conditions_f
      INTEGER dtf_query_volume_condition_f
      INTEGER dtf_update_volume_condition_f
      INTEGER dtf_delete_volume_condition_f
      INTEGER dtf_check_rep_dup_nodes_f
      INTEGER dtf_add_p3d_to_sim_f
      INTEGER dtf_strcasecmp_f
      INTEGER dtf_query_nzi_f
      INTEGER dtf_query_zi_f
      INTEGER dtf_read_zi_f
      INTEGER dtf_query_nzi_zone_f
      INTEGER dtf_query_zi_zone_f
      INTEGER dtf_read_zi_zone_f
      INTEGER dtf_query_nzi_ss_f
      INTEGER dtf_query_zi_ss_f
      INTEGER dtf_read_zi_ss_f
      INTEGER dtf_query_nzi_zone_ss_f
      INTEGER dtf_query_zi_zone_ss_f
      INTEGER dtf_read_zi_zone_ss_f
      INTEGER dtf_clear_file_connectivity_table_f
      INTEGER dtf_clear_sim_connectivity_table_f
      INTEGER dtf_clear_zone_connectivity_table_f
      INTEGER dtf_flush_file_cache_f
      INTEGER dtf_set_destruct_mode_f
      INTEGER dtf_get_destruct_mode_f
      INTEGER dtf_map_nodes_f
      INTEGER dtf_test_validity_f
      INTEGER dtf_create_empty_poly_zone_f
      INTEGER dtf_add_x_to_empty_poly_zone_f
      INTEGER dtf_add_y_to_empty_poly_zone_f
      INTEGER dtf_add_z_to_empty_poly_zone_f
      INTEGER dtf_add_f2n_to_empty_poly_zone_f
      INTEGER dtf_add_n_nodes_per_face_to_empty_poly_zone_f
      INTEGER dtf_add_f2c_to_empty_poly_zone_f
      INTEGER dtf_perturb_node_f
